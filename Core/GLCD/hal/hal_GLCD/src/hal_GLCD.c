/******************************************************************************
 * Module: GLCD
 *
 * File Name: hal_GLCD.c
 *
 * Description: Source file for the GLCD
 *
 * Author: Rahma Abdelhamid
 *
 * Created on: Nov 19, 2023
 *******************************************************************************/


/*******************************************************************************
 *                               includes                             *
 *******************************************************************************/



#include "stm32l0xx_hal.h"
#include "stdlib.h"
#include "stdint.h"
#include "main.h"
#include "hal_GLCD.h"


/*******************************************************************************
 *                             Global Variable                                 *
 *******************************************************************************/

uint8_t g_aui8TxSpi[4];

const char font5x8[] = {
0x00, 0x00, 0x00, 0x00, 0x00,// (spacja)
0x00, 0x00, 0x5F, 0x00, 0x00,// !
0x00, 0x07, 0x00, 0x07, 0x00,// "
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0x08, 0x1C, 0x2A, 0x08, 0x08 // <-
};

extern SPI_HandleTypeDef hspi1;

/*******************************************************************************
 *                              Function Definition                            *
 *******************************************************************************/

void HAL_GLCD_setDelay(void)
{
	uint8_t ui8count = 0;
	for (ui8count = 0; ui8count < 100; ui8count++)
	{
	}
}

void HAL_GLCD_writeCommand(uint8_t ui8commandToWrite)
{
	g_aui8TxSpi [0]= ui8commandToWrite;
	HAL_GPIO_WritePin(LCD_A0_GPIO_Port, LCD_A0_Pin, GPIO_PIN_RESET);
	HAL_GLCD_setDelay();
	HAL_GPIO_WritePin(LCD_NCS_GPIO_Port, LCD_NCS_Pin, GPIO_PIN_RESET);
	HAL_GLCD_setDelay();
	HAL_SPI_Transmit(&hspi1, g_aui8TxSpi, 1, HAL_MAX_DELAY);
	HAL_GLCD_setDelay();
	HAL_GPIO_WritePin(LCD_NCS_GPIO_Port, LCD_NCS_Pin, GPIO_PIN_SET);
	HAL_Delay(2);
}

void HAL_GLCD_writeData(uint8_t ui8dataToWrite)
{
	g_aui8TxSpi[0] = ui8dataToWrite;
	HAL_GPIO_WritePin(LCD_A0_GPIO_Port, LCD_A0_Pin, GPIO_PIN_SET);
	HAL_GLCD_setDelay();
	HAL_GPIO_WritePin(LCD_NCS_GPIO_Port, LCD_NCS_Pin, GPIO_PIN_RESET);
	HAL_GLCD_setDelay();
	HAL_SPI_Transmit(&hspi1, g_aui8TxSpi, 1, HAL_MAX_DELAY);
	HAL_GLCD_setDelay();
	HAL_GPIO_WritePin(LCD_NCS_GPIO_Port, LCD_NCS_Pin, GPIO_PIN_SET);
	HAL_Delay(2);
}

void HAL_GLCD_InitalizePorts(void)
{
	/* Set CS to High */
	HAL_GPIO_WritePin(LCD_NCS_GPIO_Port, LCD_NCS_Pin, GPIO_PIN_SET);
	HAL_GPIO_WritePin(LCD_NRESET_GPIO_Port, LCD_NRESET_Pin, GPIO_PIN_RESET);
	HAL_Delay(50);
	HAL_GPIO_WritePin(LCD_NRESET_GPIO_Port, LCD_NRESET_Pin, GPIO_PIN_SET);
	HAL_Delay(50);

	/* Turn off  */
	g_aui8TxSpi[0] = 0xAE;
	HAL_GLCD_writeCommand(g_aui8TxSpi[0]);

	/* 1/9 bias */
	g_aui8TxSpi[0] = 0xA2;
	HAL_GLCD_writeCommand(g_aui8TxSpi[0]);

	/* ADC Normal  */
	g_aui8TxSpi[0] = 0xA0;
	HAL_GLCD_writeCommand(g_aui8TxSpi[0]);

	/* COM Normal  */
	g_aui8TxSpi[0] = 0xC8;
	HAL_GLCD_writeCommand(g_aui8TxSpi[0]);

	/* Initial display line   */
	g_aui8TxSpi[0] = 0x40;    //Operating Mode
	HAL_GLCD_writeCommand(g_aui8TxSpi[0]);

	/* Power control Set  */
	g_aui8TxSpi[0] = 0x2F;
	HAL_GLCD_writeCommand(g_aui8TxSpi[0]);

	/* resistor ratio */
	g_aui8TxSpi[0] = 0x25;
	HAL_GLCD_writeCommand(g_aui8TxSpi[0]);

	/* contrast  */
	g_aui8TxSpi[0] = 0x81;   //electronic volume mode set
	HAL_GLCD_writeCommand(g_aui8TxSpi[0]);

	/* contrast  */
	g_aui8TxSpi[0] = 0x10;  //electronic volume register set
	HAL_GLCD_writeCommand(g_aui8TxSpi[0]);

	/* Display on   */
	g_aui8TxSpi[0] = 0xAF;
	HAL_GLCD_writeCommand(g_aui8TxSpi[0]);

	/* Page address B0   */
	g_aui8TxSpi[0] = 0xB0;
	HAL_GLCD_writeCommand(g_aui8TxSpi[0]);
}

void HAL_GLCD_Init(void)
{
	uint8_t ui8count = 0;
	HAL_GLCD_InitalizePorts();
	for (ui8count = 0; ui8count < 3; ui8count++)
	{
		HAL_GLCD_writeCommand((DISPLAY_ON_CMD | ON));
	}
}


void HAL_GLCD_goTo(uint8_t ui8Xaxis, uint8_t ui8Yaxis)
{
	HAL_GLCD_setYaddress(ui8Yaxis);
	HAL_GLCD_setXaddress(ui8Xaxis);
}


void HAL_GLCD_ClearScreen(void)
{
	uint8_t ui8count1 = 0, ui8count2 = 0;
	for (ui8count2 = 0; ui8count2 < ( SCREEN_HEIGHT / 8); ui8count2++)
	{
		HAL_GLCD_goTo(0, ui8count2);
		for (ui8count1 = 0; ui8count1 < SCREEN_WIDTH; ui8count1++)
		{
			HAL_GLCD_writeData(0x00);
		}
	}
}

void HAL_clearLineGLCD(void)
{
	uint8_t ui8count1 = 0;
	for (ui8count1 = 0; ui8count1 < SCREEN_WIDTH; ui8count1++)
	{
		HAL_GLCD_writeData(0x00);
	}
}


void HAL_GLCD_writeChar(int8_t i8charToWrite)
{
	uint8_t ui8count = 0;
	i8charToWrite -= 32;
	for (ui8count = 0; ui8count < 5; ui8count++)
	{
		HAL_GLCD_writeData(
				HAL_GLCD_readByteFromROMMemory(
						(int8_t *) ((int32_t) font5x8 + (5 * i8charToWrite) + ui8count)));
	}

	HAL_GLCD_writeData(0x00);
}


void HAL_GLCD_writeString(uint8_t *pui8stringToWrite)
{
	while (*pui8stringToWrite != '\0')
	{
		HAL_GLCD_writeChar(*pui8stringToWrite);
		pui8stringToWrite++;
	}
}

uint8_t* INT_To_String(uint32_t ui32value)
{
	uint8_t str[6] = {0};
	uint8_t *ptr=&str[5];
	*ptr='\0';
	while (ui32value!='\0')
	{
		ptr--;
		*ptr=(ui32value%10)+48;
		ui32value=ui32value/10;
	}
	return ptr;
}



uint8_t HAL_GLCD_readByteFromROMMemory(int8_t * ptr)
{
	return *ptr;
}

void HAL_GLCD_setYaddress(uint8_t ui8Yaxis)
{
	HAL_GLCD_writeCommand(ST7565R_PAGE_1_ADDRESS_SET | (0b00001111 & ui8Yaxis));
}

void HAL_GLCD_setXaddress(uint8_t ui8Xaxis)
{
	HAL_GLCD_setColumnUpper(ui8Xaxis);
	HAL_GLCD_setColumnLower(ui8Xaxis);
}

void HAL_GLCD_setColumnUpper(uint8_t ui8Addr)
{
	HAL_GLCD_writeCommand(ST7565R_COLUMN_ADDRESS_SET_UPPER | (ui8Addr >> 4));
}

void HAL_GLCD_setColumnLower(uint8_t ui8Addr)
{
	HAL_GLCD_writeCommand(ST7565R_COLUMN_ADDRESS_SET_LOWER | (0x0f & ui8Addr));
}

void HAL_GLCD_setStartLine(uint8_t ui8Addr)
{
	HAL_GLCD_writeCommand( ST7565R_SET_START_LINE | (0b00111111 & ui8Addr));
}


